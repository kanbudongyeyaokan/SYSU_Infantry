#include "Ins_task.h"

#include <stdio.h>
#include <math.h>
#include <stdbool.h>

#include "cmsis_os.h"
#include "ins.h"
#include "bmi088.h"
#include "main.h"
#include "bsp_dwt.h"
#include "algorithm_ekf.h"

// BMI088璁惧瀹炰緥
static Bmi088_device_t *bmi088_device;

#define INS_EKF_STATIC_THRESHOLD     200U
#define INS_EKF_UPDATE_THRESHOLD     500U

/**
 * @brief          ins_task
 * @param[in]      pvParameters: 绌? * @retval         none
 */
void Ins_task(void const *argument)
{
    // 鍒濆鍖朆MI088閰嶇疆
    Bmi088_config_t bmi088_config = {
        .spi_handle = &hspi1,
        .accel_cs_gpio_port = GPIOA,
        .accel_cs_gpio_pin = GPIO_PIN_4,
        .gyro_cs_gpio_port = GPIOB,
        .gyro_cs_gpio_pin = GPIO_PIN_0,
        .enable_accel_self_test = true,
        .enable_gyro_self_test = true,
        // 淇鍚庣殑鏃嬭浆鐭╅樀锛氱鍚堝彸鎵嬪潗鏍囩郴 (X鍓? Y鍙? Z涓?
        .accel_rotation = {
            {1.0f, 0.0f, 0.0f},  // 鏈轰綋X(鍓? = -IMU_X (IMU_X鎸囧悜鏈轰綋鍚庢柟)
            {0.0f, 1.0f, 0.0f},   // 鏈轰綋Y(鍙? = IMU_Y (IMU_Y鎸囧悜鏈轰綋鍙充晶)
            {0.0f, 0.0f, 1.0f}    // 鏈轰綋Z(涓? = IMU_Z (IMU_Z鎸囧悜鏈轰綋涓嬫柟)
        },
        .gyro_rotation = {
            {1.0f, 0.0f, 0.0f},  // 鏈轰綋Roll(缁昘杞? = -IMU_Roll
            {0.0f, 1.0f, 0.0f},   // 鏈轰綋Pitch(缁昚杞? = IMU_Pitch  
            {0.0f, 0.0f, 1.0f}    // 鏈轰綋Yaw(缁昛杞? = IMU_Yaw
        }
    };

    // 鍒濆鍖朎KF閰嶇疆 - 浣跨敤浼樺寲鐨勯厤缃潵淇yaw杞存紓绉?    Ekf_config_t ekf_config = {
        .process_noise_q = 10.0f,                // 杩囩▼鍣０锛堝弬鑰僎uaternionEKF锛?        .measurement_noise_r = 1000.0f,          // 娴嬮噺鍣０锛岄拡瀵箉aw婕傜Щ浼樺寲锛堟瘮鍘?000000灏忎竴浜涳級
        .gyro_bias_noise = 0.001f,               // 闄€铻轰华闆跺亸鍣０
        .dt = 0.001f,                            // 1ms, 1000Hz
        .enable_bias_correction = true,          // 鍚敤闆跺亸鏍℃
        .static_threshold = 0.3f,                // 闈欐€佹娴嬮槇鍊硷紙鍙傝€僎uaternionEKF锛?        .fading_factor = 0.9996f,                // 鍏抽敭鍙傛暟锛佹笎鍑忓洜瀛愶紝闃叉闆跺亸杩囧害鏀舵暃

        // 鏂板娓╁害琛ュ伩閰嶇疆
        .enable_temp_compensation = true,        // 鍚敤娓╁害琛ュ伩
        .temp_coeff_x = 0.01f * (3.14159265f / 180.0f), // X杞存俯搴︾郴鏁?0.01掳/s/掳C
        .temp_coeff_y = 0.01f * (3.14159265f / 180.0f), // Y杞存俯搴︾郴鏁?0.01掳/s/掳C  
        .temp_coeff_z = 0.015f * (3.14159265f / 180.0f),// Z杞存俯搴︾郴鏁?0.015掳/s/掳C锛堢◢澶т竴浜涳級
        .baseline_temp = 25.0f                   // 鍩哄噯娓╁害25掳C
    };

    // 鍘熷閰嶇疆锛堝凡浼樺寲涓轰笂闈㈢殑閰嶇疆锛?    // Ekf_config_t ekf_config = {
    //     .process_noise_q = 0.01f,
    //     .measurement_noise_r = 0.1f,
    //     .gyro_bias_noise = 0.001f,
    //     .dt = 0.001f, // 1ms, 1000Hz
    //     .enable_bias_correction = true,
    //     .static_threshold = 0.2f};

    // 璺冮箍 EKF 鐨勯厤缃紙宸叉暣鍚堝埌涓婇潰鐨勪紭鍖栭厤缃腑锛?    // Ekf_config_t ekf_config = {
    //     .process_noise_q = 10.0f,                // 澧炲ぇ杩囩▼鍣０锛屾彁楂樺搷搴旀€э紙鍙傝€僎uaternionEKF鐢?0锛?    //     .measurement_noise_r = 1000000.0f,       // 鍑忓皬娴嬮噺鍣０鐨勫奖鍝嶏紙鍙傝€僎uaternionEKF鐢?000000锛?    //     .gyro_bias_noise = 0.001f,               // 淇濇寔闆跺亸鍣０涓嶅彉
    //     .dt = 0.001f,                            // 1ms, 1000Hz
    //     .enable_bias_correction = true,
    //     .static_threshold = 0.3f                 // 鎻愰珮闈欐€侀槇鍊硷紝鍑忓皯璇垽锛堝弬鑰僎uaternionEKF鐢?.3锛?    // };

    // 鍒濆鍖朆MI088璁惧
    bmi088_device = Bmi088_device_init(&bmi088_config);
    if (bmi088_device != NULL)
    {
        // 鍒濆鍖朎KF
        Bmi088_error_e ekf_init_result = Bmi088_ekf_init(bmi088_device, &ekf_config);
        if (ekf_init_result == NO_ERROR) {
            // printf("INS EKF initialized successfully with optimized parameters!\n");
            // printf("Yaw drift fix configuration:\n");
            // printf("   - Process noise: %.1f\n", ekf_config.process_noise_q);
            // printf("   - Measurement noise: %.1f\n", ekf_config.measurement_noise_r);
            // printf("   - Fading factor: %.6f (KEY parameter!)\n", ekf_config.fading_factor);
            // printf("   - Static threshold: %.1f rad/s\n", ekf_config.static_threshold);
        } else {
            // printf("EKF initialization failed! Error: %d\n", ekf_init_result);
        }
    } else {
        // printf("BMI088 initialization failed!\n");
    }

    Imu_state_e published_state = (bmi088_device != NULL) ? bmi088_device->data.state : IMU_STATE_INIT;
    update_attitude_data(NULL, NULL, NULL, NULL, published_state);

    for (;;)
    {
        if (bmi088_device == NULL)
        {
            if (published_state != IMU_STATE_ERROR) {
                published_state = IMU_STATE_ERROR;
                update_attitude_data(NULL, NULL, NULL, NULL, published_state);
                // printf("INS device not initialized\n");
            }
            osDelay(10);
            continue;
        }

        Imu_state_e current_state = bmi088_device->data.state;

        if (bmi088_device->last_error != NO_ERROR) {
            if (current_state != IMU_STATE_ERROR) {
                // printf("INS sensor error detected (code=%d)\n", bmi088_device->last_error);
            }
            bmi088_device->data.state = IMU_STATE_ERROR;
            if (published_state != IMU_STATE_ERROR) {
                update_attitude_data(NULL, NULL, NULL, NULL, IMU_STATE_ERROR);
                published_state = IMU_STATE_ERROR;
            }
            osDelay(1);
            continue;
        }

        if (current_state == IMU_STATE_INIT) {
            if (published_state != IMU_STATE_INIT) {
                update_attitude_data(NULL, NULL, NULL, NULL, IMU_STATE_INIT);
                published_state = IMU_STATE_INIT;
            }
            osDelay(1);
            continue;
        }

        // 娓╁害琛ュ伩锛氳鍙朆MI088鐨勬俯搴︽暟鎹苟璁剧疆鍒癊KF
        float current_temp = Bmi088_get_temperature(bmi088_device);
        Ekf_set_temperature(&bmi088_device->data.ekf_state, current_temp);

        // 鏇存柊EKF锛堟鍑芥暟鍐呴儴浼氳嚜鍔ㄨ鍙栦紶鎰熷櫒鏁版嵁锛?        Bmi088_error_e update_result = Bmi088_ekf_update(bmi088_device);

        if (update_result == NO_ERROR) {
            // 鑾峰彇鏇存柊鍚庣殑鏁版嵁
            Acc_raw_data_t *acc_data = Read_acc_data(bmi088_device);
            Gyro_raw_data_t *gyro_data = Read_gyro_data(bmi088_device);
            Euler_angles_t *euler_angles = Bmi088_get_euler_angles(bmi088_device);

            // 鏇存柊鍒癷ns妯″潡
            if (acc_data && gyro_data && euler_angles)
            {
                Acc_raw_data_t acc_body = {0};
                Gyro_raw_data_t gyro_body = {0};

                const float (*acc_rot)[3] = bmi088_device->config.accel_rotation;
                const float (*gyro_rot)[3] = bmi088_device->config.gyro_rotation;

                acc_body.x = acc_rot[0][0] * acc_data->x + acc_rot[0][1] * acc_data->y + acc_rot[0][2] * acc_data->z;
                acc_body.y = acc_rot[1][0] * acc_data->x + acc_rot[1][1] * acc_data->y + acc_rot[1][2] * acc_data->z;
                acc_body.z = acc_rot[2][0] * acc_data->x + acc_rot[2][1] * acc_data->y + acc_rot[2][2] * acc_data->z;

                gyro_body.roll = gyro_rot[0][0] * gyro_data->roll + gyro_rot[0][1] * gyro_data->pitch + gyro_rot[0][2] * gyro_data->yaw;
                gyro_body.pitch = gyro_rot[1][0] * gyro_data->roll + gyro_rot[1][1] * gyro_data->pitch + gyro_rot[1][2] * gyro_data->yaw;
                gyro_body.yaw = gyro_rot[2][0] * gyro_data->roll + gyro_rot[2][1] * gyro_data->pitch + gyro_rot[2][2] * gyro_data->yaw;

                Imu_state_e new_state = IMU_STATE_CALIBRATING;
                bool ekf_converged = false;
                if (bmi088_device->data.ekf_state.update_count >= INS_EKF_UPDATE_THRESHOLD &&
                    bmi088_device->data.ekf_state.static_count >= INS_EKF_STATIC_THRESHOLD) {
                    ekf_converged = true;
                }

                if (ekf_converged) {
                    new_state = IMU_STATE_READY;
                    if (current_state != IMU_STATE_READY) {
                        // printf("INS ready: static_count=%u, update_count=%lu\n",
                               // (unsigned)bmi088_device->data.ekf_state.static_count,
                               // (unsigned long)bmi088_device->data.ekf_state.update_count);
                    }
                }

                bmi088_device->data.state = new_state;
                update_attitude_data(&acc_body,
                                     &gyro_body,
                                     euler_angles,
                                     (new_state == IMU_STATE_READY) ? &bmi088_device->data.ekf_state.yaw_total_angle : NULL,
                                     new_state);
                published_state = new_state;
            }

            // 楂橀杈撳嚭 - 鍘熸湁鐨勮皟璇曟墦鍗帮紙鍙€夋嫨鍚敤/绂佺敤锛?            // printf("[quaternionl]q0/q1/q2/q3 [euler]pitch/roll/yaw [temp]:%f,%f,%f,%f,%f,%f,%f,%f\r\n",
            //       bmi088_device->data.ekf_state.quaternion.q0,
            //       bmi088_device->data.ekf_state.quaternion.q1,
            //       bmi088_device->data.ekf_state.quaternion.q2,
            //       bmi088_device->data.ekf_state.quaternion.q3,
            //       euler_angles->pitch,
            //       euler_angles->roll,
            //       euler_angles->yaw,
            //       current_temp
            //     //   gyro_data->pitch,
            //     //   gyro_data->roll,
            //     //   gyro_data->yaw
            //     );

        } else {
            // EKF鏇存柊澶辫触锛岃緭鍑洪敊璇俊鎭?            static uint32_t error_count = 0;
            if (++error_count % 1000 == 0) {
                // printf("EKF update error count: %d\n", error_count);
            }
            if (current_state != IMU_STATE_ERROR) {
                // printf("INS readiness revoked: EKF update error\n");
            }
            bmi088_device->data.state = IMU_STATE_ERROR;
            update_attitude_data(NULL, NULL, NULL, NULL, IMU_STATE_ERROR);
            published_state = IMU_STATE_ERROR;
        }
        // 1000Hz
        osDelay(1);
    }
}
